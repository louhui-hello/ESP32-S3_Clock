## tools/i2c_scan/i2c_scan/sdkconfig.defaults
```kconfig
CONFIG_IDF_TARGET="esp32s3"

# 控制台走原生 USB（模组自带 USB-Serial/JTAG，板上没有 CH340）
CONFIG_ESP_CONSOLE_USB_SERIAL_JTAG=y
CONFIG_ESP_CONSOLE_SECONDARY_NONE=y

# N16R8：16MB flash + 8MB 八线 PSRAM
CONFIG_ESPTOOLPY_FLASHSIZE_16MB=y
CONFIG_ESP_DEFAULT_CPU_FREQ_MHZ_240=y

CONFIG_SPIRAM=y
CONFIG_SPIRAM_MODE_OCT=y
CONFIG_SPIRAM_SPEED_80M=y
CONFIG_SPIRAM_BOOT_INIT=y
```
